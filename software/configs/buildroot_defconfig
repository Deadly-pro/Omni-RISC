## software/configs/buildroot_defconfig
```kconfig
BR2_riscv=y
BR2_riscv_32=y
BR2_riscv_isa_custom=y
BR2_riscv_isa_custom_rvm=y
BR2_riscv_isa_custom_rva=y
BR2_riscv_isa_custom_rvc=y
BR2_riscv_isa_custom_rvf=y
BR2_riscv_isa_custom_rvd=y
BR2_riscv_abi_ilp32d=y
BR2_TOOLCHAIN_BUILDROOT_WCHAR=y
BR2_TARGET_GENERIC_GETTY_PORT="ttyS0"
BR2_SYSTEM_DHCP="eth0"
BR2_LINUX_KERNEL=y
BR2_LINUX_KERNEL_CUSTOM_VERSION=y
BR2_LINUX_KERNEL_CUSTOM_VERSION_VALUE="6.6.22"
BR2_LINUX_KERNEL_USE_ARCH_DEFAULT_CONFIG=y
BR2_LINUX_KERNEL_CONFIG_FRAGMENT_FILES="software/configs/linux_vector.config"
BR2_TARGET_ROOTFS_EXT2=y
BR2_TARGET_OPENSBI=y
BR2_TARGET_OPENSBI_PLAT="generic"
```
